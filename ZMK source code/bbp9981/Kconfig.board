## ZMK source code/bbp9981/Kconfig.board
```kconfig
# Copyright (c) 2025 ZitaoTech
# SPDX-License-Identifier: MIT

config BOARD_BBP9981
    bool "bbp9981"
    depends on SOC_NRF52840_QIAA

menu "A320 Trackpad Setting"

config A320_TRACKPAD_SCROLL_INTERVAL
    int "Trackpad scroll in miliseconds"
    default 50
    range 0 200
    help
      The bigger this value, the slower the trackpad scrolls

config A320_LOG_LEVEL
	int "Log Level for Touch"
	default 4

config A320
	bool "A320 Driver"
	depends on I2C && GPIO
	help
	  Projected capacitive trackpad/touchscreen controller.

config INPUT_A320_INIT_PRIORITY
  int "A320 Initialization Priority"
  default 90

endmenu
```

## ZMK source code/bbp9981/Kconfig.defconfig
```kconfig
# Copyright (c) 2025 ZitaoTech
# SPDX-License-Identifier: MIT

if BOARD_BBP9981

config ZMK_KEYBOARD_NAME
    default "bbp9981"

if USB_DEVICE_STACK

config USB_NRFX
    default y

endif # USB_DEVICE_STACK

if ZMK_BACKLIGHT

config PWM
    default y

config LED_PWM
    default y

endif # ZMK_BACKLIGHT

config BT_CTLR
    default BT

endif # BOARD_BBP9981
```

## ZMK source code/bbp9981/bbp9981_defconfig
```kconfig
# Copyright (c) 2025 ZitaoTech
# SPDX-License-Identifier: MIT

CONFIG_SOC_SERIES_NRF52X=y
CONFIG_SOC_NRF52840_QIAA=y
CONFIG_BOARD_BBP9981=y

# Enable MPU
CONFIG_ARM_MPU=y

CONFIG_PINCTRL=y

# enable GPIO
CONFIG_GPIO=y

# Build Configuration
CONFIG_USE_DT_CODE_PARTITION=y
CONFIG_BUILD_OUTPUT_UF2=y

# Flash configuration
CONFIG_MPU_ALLOW_FLASH_WRITE=y
CONFIG_NVS=y
CONFIG_SETTINGS_NVS=y
CONFIG_FLASH=y
CONFIG_FLASH_PAGE_LAYOUT=y
CONFIG_FLASH_MAP=y

# Enable Signal Power Plus
CONFIG_BT_CTLR_TX_PWR_PLUS_8=y

# Sleep Setting
CONFIG_ZMK_SLEEP=n
CONFIG_ZMK_EXT_POWER=y
# timeout for backlight for keyboard in miliseconds
CONFIG_ZMK_IDLE_TIMEOUT=30000                         

# Keyboard backlight Setting
# enable keyboard backlight
CONFIG_ZMK_BACKLIGHT=y                                
# set the brightness the keyboard backlight when powered on in 1-100
CONFIG_ZMK_BACKLIGHT_BRT_START=40                     
# set the brightness step for each change of backlight brightness
CONFIG_ZMK_BACKLIGHT_BRT_STEP=10                      
# enable keyboard backlight on when powered on
CONFIG_ZMK_BACKLIGHT_ON_START=y                       
# enable automatic turn off when no keypress detected
CONFIG_ZMK_BACKLIGHT_AUTO_OFF_IDLE=y                  

# RGB backlight setting for Backlight turn on/off of keyboard
CONFIG_ZMK_RGB_UNDERGLOW=y
CONFIG_ZMK_RGB_UNDERGLOW_EXT_POWER=n
CONFIG_WS2812_STRIP=y

# HID indicator configuration
CONFIG_ZMK_HID_INDICATORS=y

# Trackpad and the scroll speed setting
CONFIG_I2C=y
CONFIG_I2C_NRFX=y
# Set the scroll interval; the highter this value, the slower trackpad scrolls                   
CONFIG_A320_TRACKPAD_SCROLL_INTERVAL=50           

# Enable Mouse
CONFIG_ZMK_POINTING=y

# Debuncing Setting 
CONFIG_ZMK_KSCAN_DEBOUNCE_PRESS_MS=10
CONFIG_ZMK_KSCAN_DEBOUNCE_RELEASE_MS=10

# Enable both USB and BLE
CONFIG_ZMK_USB=y
CONFIG_ZMK_BLE=y

# Milliseconds to wait after a setting change before writing it to flash memory
CONFIG_ZMK_SETTINGS_SAVE_DEBOUNCE=1000

# ZMK Studio
CONFIG_ZMK_STUDIO=y
CONFIG_ZMK_STUDIO_LOCKING=n
CONFIG_ZMK_STUDIO_LOCK_ON_DISCONNECT=n

# Log via USB or Segger RTT
CONFIG_ZMK_USB_LOGGING=n
# CONFIG_LOG_PROCESS_THREAD_STARTUP_DELAY_MS=4000
```
